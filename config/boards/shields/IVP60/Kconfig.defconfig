## config/boards/shields/IVP60/Kconfig.defconfig
```kconfig
if SHIELD_IVP60_LEFT

# Name must be less than 16 characters long!
config ZMK_KEYBOARD_NAME
	default "IVP60"

config ZMK_SPLIT_ROLE_CENTRAL
	default y

endif

if SHILED_IVP60_LEFT || SHIELD_MY_KEYBOARD_RIGHT

config ZMK_SPLIT
	default y

endif
```
