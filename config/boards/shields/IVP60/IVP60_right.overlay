#include "IVP60.dtsi" // The shared dtsi file is included in the overlay

&default_transform { // offset of 3 because the left side has 3 colums
	col-offset = <3>;
};


&kscan0 {
	col-gpios = <&gpio0 19 GPIO_ACTIVE_HIGH>
	          , <&gpio0 20 GPIO_ACTIVE_HIGH>
	          , <&gpio0 21 GPIO_ACTIVE_HIGH>
						;
};
