#include "IVP60.dtsi" // The shared dtsi file is included in the overlay

&kscan0 {
	col-gpios = <&gpio0 24 GPIO_ACTIVE_HIGH>
	          , <&gpio0 25 GPIO_ACTIVE_HIGH>
	          , <&gpio0 26 GPIO_ACTIVE_HIGH>
						;
};
